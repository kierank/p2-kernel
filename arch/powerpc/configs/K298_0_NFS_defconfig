## arch/powerpc/sysdev/Kconfig
```kconfig
# For a description of the syntax of this configuration file,
# see Documentation/kbuild/kconfig-language.txt.
#
## $Id: Kconfig 9139 2010-09-14 00:43:11Z Noguchi Isao $

config PPC4xx_PCI_EXPRESS
	bool
	depends on PCI && 4xx
	default n

## 2010/6/8, deleted by Panasonic
#config PPC_MPC83XX_PCIE
#	bool "MPC837X and MPC831x PCI Express support"
#	depends on PPC_MPC837x || PPC_MPC831x
#	depends on PCIEPORTBUS
#	help
#	  This option enables PCI express for MPC837x and MPC831x
```

## drivers/p2pf/Kconfig
```kconfig
# drivers/p2pf/Kconfig
# $Id: Kconfig 14403 2011-05-18 02:58:59Z Noguchi Isao $

menu "Panasonic P2PF Proprientary Modules"

config P2PF
	bool "P2PF platform"
	default y
	help
	  Select this option if you don't have magic firmware for drivers that
	  need it.

	  If unsure, say Y.

if P2PF

source "drivers/p2pf/p2pfinfo/Kconfig"
source "drivers/p2pf/dm/Kconfig"
source "drivers/p2pf/rtctrl/Kconfig"
source "drivers/p2pf/zcom/Kconfig"
source "drivers/p2pf/buffer/Kconfig"
source "drivers/p2pf/p2ioport/Kconfig"
source "drivers/p2pf/proxy/Kconfig"

if PPC_83xx
source "drivers/p2pf/mpc83xxdmac/Kconfig"
endif

source "drivers/p2pf/heartbeat/Kconfig"
source "drivers/p2pf/zion/Kconfig"


#
# Optional initialization for Ricoh bridges
#
menuconfig P2PF_RICOH_OPTION
	bool "Ricoh bridge optional initialization"
    default n
    ---help---
        this option enables the optional initialization for Ricoh bridges.

		If unsure, say "N".

if P2PF_RICOH_OPTION

choice
    prompt "Select Ricoh bridge device"
    depends on P2PF_RICOH_OPTION
    ---help---
        this option enables to select RICHO bridge.

config P2PF_RICOH_UNKNOWN
    bool "UNKNOWN"
    depends on P2PF_RICOH_OPTION

config P2PF_RICOH_R5C812
    bool "R5C512"
    depends on P2PF_RICOH_OPTION

config P2PF_RICOH_R5C847
    bool "R5C547"
    depends on P2PF_RICOH_OPTION

endchoice    

## function disable forcely

config P2PF_RICOH_FUNC_DISABLE
    bool "Function Disable"
    depends on !P2PF_RICOH_UNKNOWN
    default n
    ---help---
        This option is used to disables each functions forcely.

		If unsure, say "N".

if P2PF_RICOH_FUNC_DISABLE

config P2PF_RICOH_SLOTB_DISABLE
    bool "Disables PC Card slotB i/f forcely"
    depends on P2PF_RICOH_R5C812
    default n
    ---help---
        This option disables PC Card slotB i/f forcely.

config P2PF_RICOH_SD_DISABLE
    bool "Disables SD Card i/f forcely"
    depends on P2PF_RICOH_R5C812 || P2PF_RICOH_R5C847
    default n
    ---help---
        This option disables SD Card i/f forcely.

config P2PF_RICOH_MS_DISABLE
    bool "Disables Memory Stick Card i/f forcely"
    depends on P2PF_RICOH_R5C812 || P2PF_RICOH_R5C847
    default n
    ---help---
        This option disables Memory Stick Card i/f forcely.

config P2PF_RICOH_MMC_DISABLE
    bool "Disables MMC i/f forcely"
    depends on P2PF_RICOH_R5C847
    default n
    ---help---
        This option disables MMC i/f forcely.

config P2PF_RICOH_XD_DISABLE
    bool "Disables xD Picture Card i/f forcely"
    depends on P2PF_RICOH_R5C847
    default n
    ---help---
        This option disables xD Picture Card i/f forcely.

config P2PF_RICOH_1394_DISABLE
    bool "Disables 1394 i/f forcely"
    depends on P2PF_RICOH_R5C847
    default n
    ---help---
        This option disables 1394 i/f forcely.

config P2PF_RICOH_EXPRESS_DISABLE
    bool "Disables Express Card i/f forcely"
    depends on P2PF_RICOH_R5C812
    default n
    ---help---
        This option disables Express Card i/f forcely.

config P2PF_RICOH_PC_DETECT_DISABLE
    bool "Disables PC Card Detection forcely"
    depends on P2PF_RICOH_R5C847
    default n
    ---help---
        This option disables PC Card Detection forcely.

config P2PF_RICOH_EXPRESS_DETECT_DISABLE
    bool "Disables Express Card Detection forcely"
    depends on P2PF_RICOH_R5C847
    default n
    ---help---
        This option disables  Express Card Detection forcely.

endif # P2PF_RICOH_FUNC_DISABLE

endif # P2PF_RICOH_OPTION

#-------------------------------------------------------------------------------


#
# SCSI extention for p2pf
#
menuconfig P2PF_SCSI
    bool "SCSI extention for p2pf"
	depends on SCSI
    default n

if P2PF_SCSI

# Extendig maximum number of the SCSI disk partition
config	P2PF_SCSI_DISK_PAT_EX
	bool "Extend maximum number of the disk partition (16-->32)"
	default n
	help
		This option extending maximum number of the SCSI disk partition
		to 32 from 16.

# Enabling 16bytes CDB with SG_IO
config  P2PF_SGIO_CDB16
	bool "Enabling 16bytes CDB with SG_IO"
	default n
	help
		This option enabling 16bytes CDB with SG_IO.

# Supporting SCSI Disk (USB/SATA)  hot-plug detection, disk maintenance
# functionalities, and data transfer beteen buffer and device.
# Modified 2008-sep-24:
config	P2PF_SCSI_DISK_FUNC
	bool "Functionality extentions for P2PF (SCSI Disk driver)"
	default n
	help
		Select this option enabling SCSI Disk (USB/SATA) hot-plug insertion
		and removal detection and other functionalities for user space
		applications.

		If unsure, say "N".

## We support two method of detecting a disk hotplug
##  *Use SCSI disk driver extention
##  *Use "sysfs" extention
#choice
#	bool "Select method of detecting hot-plug"
#	depends on P2PF_SCSI_DISK_FUNC
#	default P2PF_HOTPLUG_METH_SD
#	help
#		We support two method of detecting a disk hotplug, then
#		select one of two.
#
#config	P2PF_HOTPLUG_METH_SD
#	boolean "Use SCSI driver extention (default)"
#	help
#		No help available.
#
#config	P2PF_HOTPLUG_METH_SYSFS
#	boolean "Use sysfs extention (EXPERIMENTAL)"
#	help
#		No help available.
#
#endchoice

# detecting SCSI block device error
config P2PF_SCSI_DISK_BLK_ERROR
    bool "Enable detecting SCSI block device error"
    default n
    depends on P2PF_SCSI_DISK_FUNC
    help
	  Select this option if you would like to detect SCSI block device error.

	  If unsure, say Y.
        
# /proc file to debug SCSI DISK
config P2PF_SCSI_DISK_PROC_FS
    bool "Enable /proc file to debug SCSI DISK"
    default n
    depends on PROC_FS && P2PF_SCSI_DISK_FUNC
    help
	  Select this option if you need proc filesystem for scsi disk.

	  If unsure, say Y.

# ## 2010/6/3, Added by Panasonic ==>
#
# # USB port test
# config P2PF_SCSI_DISK_USB_PORT_TEST
#    bool "Enable USB port test"
#    default n
#    depends on P2PF_SCSI_DISK_FUNC
#    help
#      This option enables USB port test function.
#
#	  If unsure, say Y.
#
# ## <== 2010/6/3, Added by Panasonic

endif # P2PF_SCSI

#-------------------------------------------------------------------------------



# CODEC_VGA driver
source "drivers/p2pf/codec_vga/Kconfig"

# P2GPIO
source "drivers/p2pf/p2gpio/Kconfig"

# power management depends on p2pf machines
source "drivers/p2pf/pm/Kconfig"

# P2MSU devices
source "drivers/p2pf/msudev/Kconfig"

## 2010/7/30, adeed by Panasonic
# verifier
source "drivers/p2pf/verify/Kconfig"

# CONFIG_DTS_FLAGS
config DTS_FLAGS
    bool "Change DTS compile flags ?"
    default n
	---help---
    Enable this option if you want to change compile option for DTS.
    If this option is disable, flag is "-p 1024".
    See "arch/powerpc/boot/Makefile"

config DTS_FLAGS_STRING
    string "DTS compile flags"
    depends on DTS_FLAGS

endif # P2PF

endmenu


#-----------------------------------------------------------------------
# Fast bootup menu
#

menu "Fast bootup setup"

config RET_LOGLEVEL
	bool "Return console loglevel to default"
	default n
	help
	  Select this option if you need to print kernel messages after bootup.

	  If unsure, say N.


config DISABLE_INIT_MESSAGE
	bool "Disable init messages"
	default n
	help
	  Select this option if you need to print no arch init messages for fast bootup

	  If unsure, say N.

config DISABLE_SDPROBE_MESSAGE
	bool "Disable SCSI-Disk probe messages"
	default n
	help
	  Select this option if you need to print SCSI-Disk probe messages for fast bootup

	  If unsure, say N.

endmenu
```

## drivers/p2pf/buffer/Kconfig
```kconfig
# [SBG-SAV] Revised by Panasonic 2008-APR-01, for "ua" application
# =====>
config P2USB_BUFFER
    tristate "Buffer Driver for P2 USB peripheral functionality (DEBUG)"
    help
      The Buffer Driver for P2 USB Mass Storage (USB Gadget).

config BUFFER_DM
    bool "Use DM"
    depends on P2USB_BUFFER && DM

menu "Buffer driver options"
    depends on P2USB_BUFFER

config BUFFER_SIZE_ORDER
    int "Order of Buffer Size"
    default 10
    help
      This parameter is the order of buffer size.
      Default size is 10.

config BUFFER_NUM
    int "Block Number of Buffer"
    default 3
    help
      This parameter is the block number of buffer.
      Default number is 3.

endmenu

# <=====
```

## drivers/p2pf/codec_vga/Kconfig
```kconfig
# drivers/spd/Kconfig
# $Id: Kconfig 5901 2010-03-24 23:56:01Z Noguchi Isao $

menuconfig CODEC_VGA
	bool "CODEC-VGA Driver" 
    depends on ! ZION_VGA && FB
	help
	  Select this option if you don't have magic firmware for drivers that
	  need it.
	  If unsure, say Y.

if CODEC_VGA

config CODEC_VGA_OF
    bool "Get resource by OF description"
    default n

if ! CODEC_VGA_OF

config CODEC_VGA_REG_ADDR
    hex "CODEC-VGA control regsiter address"
    default 0xe8001000

config CODEC_VGA_REG_SIZE
    hex "CODEC-VGA control regsiter byte size"
    default 0x1000
    
config CODEC_VGA_FB_ADDR
    hex "CODEC-VGA frame buffer address"
    default 0xec000000

config CODEC_VGA_FB_SIZE
    hex "CODEC-VGA frame buffer byte size"
    default 0x02000000

config CODEC_VGA_SPRITE_NUM
    int "CODEC-VGA sprite number"
    default 4

config CODEC_VGA_SPRITE_START_ADDR
    hex "CODEC-VGA sprite buffer start address"
    default 0xe8004000

config CODEC_VGA_SPRITE_SIZE
    hex "CODEC-VGA sprite buffer size"
    default 0x1000

endif # ! CODEC_VGA_OF


config CODEC_VGA_BUFF_NUM
	int "CODEC-VGA buffer Number"
	default 32

config CODEC_VGA_LFB_NUM
	int "CODEC-VGA Local FB Number"
	default 2

config CODEC_VGA_DMA_CH
    int "CODEC-VGA DMAC Channel to use [0-3]"
    default 3
    depends on ! CODEC_VGA_OF

config CODEC_VGA_NO_RESET
    bool "Don't reset CODEC-VGA at initializing"
    default n

endif # CODEC_VGA
```

## drivers/p2pf/dm/Kconfig
```kconfig
# DM(Domestic Memory) driver configurations

config DM
        bool "DM(Domestic Memory) Driver"

menu "DM options"
	depends on DM

config DM_BLOCKUNIT_NUM
	int "The number of block size units"
	default 256
	---help---
	  This parameter is the number of block size units.
	  The total memory size for DM is defined by
	    DM_MALLOC_SIZE = DM_BLOCKUNIT_SIZE(=0x8000) * [this parameter].
	  Default number is 256(=8MB).

config DM_MALLOC_MAX_SIZE
	hex "The maximum size of DM malloc"
	default 0x00200000
	---help---
	  This parameter is the maximum size of DM malloc.
	  Default size is 0x00200000(=2MB).

config DM_ORDER
	int "The order of DM page size"
	default 10
	---help---
	  This parameter "MAX_ORDER" depends on the kernel and the architecture.
	  In SH4 on Linux 2.4, PAGE_SIZE=4096B MAX_ORDER=9.
	  In MPC83xx on Linux 2.6, PAGE_SIZE=4096B MAX_ORDER=10.

config DM_FREELIST_NUM
	int "The number of DM freelist"
	default 20
	---help---
	  When you set size of "free list table" on K,
	  continuous blocks more than K belong to the Kth list.
	  In this system, we prepare list for 1-19, and for more than 20.

endmenu
```

## drivers/p2pf/heartbeat/Kconfig
```kconfig
# drivers/p2pf/heartbeat/Kconfig

config HEART_BEAT
	bool "Heartbeat LED"
	depends on P2IOPORTDRV
	help
	  Select this option if you need to blink heartbeat led.

	  If unsure, say Y.
```

## drivers/p2pf/mpc83xxdmac/Kconfig
```kconfig
config 83XXDMAC
        bool "MPC83XX DMAC Driver"

menu "MPC83XX DMAC driver options"
	depends on 83XXDMAC

config MPC83XXDMAC_PAGE_ORDER
	int "The order of DMA buffer size"
	range 0 11
	default 8
	---help---
	  This parameter is the order of DMA buffer size alloced beforehand.
	  Default is order 8 for 1 frame size (576000Byte).

endmenu
```

## drivers/p2pf/msudev/Kconfig
```kconfig
# drivers/p2pf/msudev/Kconfig
# $Id: Kconfig 5608 2010-03-09 08:03:31Z Noguchi Isao $

menuconfig MSUDEV
	bool "P2MSU devices support" 
    default n
	help
	  Select this option if you don't have magic firmware for drivers that
	  need it.
	  If unsure, say Y.

if MSUDEV

# ADC
source "drivers/p2pf/msudev/adc/Kconfig"

# KEY
source "drivers/p2pf/msudev/keyev/Kconfig"

# LED
source "drivers/p2pf/msudev/led/Kconfig"

# BUZZER
source "drivers/p2pf/msudev/buzzer/Kconfig"

endif # MSUDEV
```

## drivers/p2pf/msudev/adc/Kconfig
```kconfig
# drivers/p2pf/msudev/adc/Kconfig
# $Id: Kconfig 5704 2010-03-15 01:18:50Z Noguchi Isao $

menuconfig MSUDEV_ADC
    tristate "Support A/D-C input device"
    default n

if MSUDEV_ADC


config MSUDEV_ADC_FIXED_DEVNUM
    boolean "Enabled to fixed major number"
    default n

config MSUDEV_ADC_FIXED_MAJOR
    int "Major number"
    depends on MSUDEV_ADC_FIXED_DEVNUM
    default 245

config MSUDEV_ADC_FIXED_MINOR
    int "Minor number"
    depends on MSUDEV_ADC_FIXED_DEVNUM
    default 32

choice
    boolean "Select lower level device"
    default MSUDEV_ADC_DEV_NONE

config  MSUDEV_ADC_DEV_DUMMY
    boolean "dummy lower-level driver"
    depends on MSUDEV_ADC

config MSUDEV_ADC_DEV_FPGA
    boolean "lower-level driver inplemented for FPGA"
    depends on MSUDEV_ADC

config MSUDEV_ADC_DEV_NONE
    boolean "lower-level driver is NOT exit"
    depends on MSUDEV_ADC

endchoice

# for dummy port
if MSUDEV_ADC_DEV_DUMMY

config MSUDEV_ADC_DEV_DUMMY_CAHN_NUMBER
    int "number of dummy channel"
    default 1

endif # MSUDEV_ADC_DEV_DUMMY

# for ADC implemented on FPGA
if MSUDEV_ADC_DEV_FPGA

config MSUDEV_ADC_DEV_FPGA_OF
    bool "getting resouces by OF description"
    default y

config MSUDEV_ADC_DEV_FPGA_NUMBER
    int "number of adc"
    depends on !MSUDEV_ADC_DEV_FPGA_OF
    default 1

config MSUDEV_ADC_DEV_FPGA_PADDR
    hex "physical start address of registers"
    depends on !MSUDEV_ADC_DEV_FPGA_OF
    
config MSUDEV_ADC_DEV_FPGA_PSIZE
    hex "byte size of registers"
    depends on !MSUDEV_ADC_DEV_FPGA_OF

endif # MSUDEV_ADC_DEV_FPGA

config MSUDEV_ADC_PROC
    boolean "Support /proc file for debug"
    default n
    depends on PROC_FS

endif # MSUDEV_ADC
```

## drivers/p2pf/msudev/buzzer/Kconfig
```kconfig
# drivers/p2pf/msudev/buzzer/Kconfig
# $Id: Kconfig 5704 2010-03-15 01:18:50Z Noguchi Isao $

menuconfig MSUDEV_BUZZER
    tristate "Support BUZZER device"
    default n

if MSUDEV_BUZZER


config MSUDEV_BUZZER_FIXED_DEVNUM
    boolean "Enaled to fixed major number"
    default n

config MSUDEV_BUZZER_FIXED_MAJOR
    int "Major number"
    depends on MSUDEV_BUZZER_FIXED_DEVNUM
    default 245

config MSUDEV_BUZZER_FIXED_MINOR
    int "Minor number"
    depends on MSUDEV_BUZZER_FIXED_DEVNUM
    default 35

choice
    boolean "Select lower level device"
    default MSUDEV_BUZZER_DEV_NONE

#config  MSUDEV_BUZZER_DEV_DUMMY
#    boolean "dummy lower-level driver"
#    depends on MSUDEV_BUZZER

config MSUDEV_BUZZER_DEV_FPGA
    boolean "lower-level driver inplemented on FPGA"
    depends on MSUDEV_BUZZER

config MSUDEV_BUZZER_DEV_NONE
    boolean "lower-level driver is NOT exit"
    depends on MSUDEV_BUZZER

endchoice

## for dummy BUZZER
#if MSUDEV_BUZZER_DEV_DUMMY

#endif # MSUDEV_BUZZER_DEV_DUMMY

# for BUZZER implemented on FPGA
if MSUDEV_BUZZER_DEV_FPGA

config MSUDEV_BUZZER_DEV_FPGA_OF
    bool "getting resouces by OF description"
    default y

config MSUDEV_BUZZER_DEV_FPGA_PADDR
    hex "physical start address of registers"
    depends on !MSUDEV_BUZZER_DEV_FPGA_OF
    
config MSUDEV_BUZZER_DEV_FPGA_PSIZE
    hex "byte size of registers"
    depends on !MSUDEV_BUZZER_DEV_FPGA_OF

endif # MSUDEV_BUZZER_DEV_FPGA

config MSUDEV_BUZZER_PROC
    boolean "Support /proc file for debug"
    default n
    depends on PROC_FS

endif # MSUDEV_BUZZER
```
