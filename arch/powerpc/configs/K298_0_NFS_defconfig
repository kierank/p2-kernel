## drivers/p2pf/msudev/keyev/Kconfig
```kconfig
# drivers/p2pf/msudev/keyev/Kconfig
# $Id: Kconfig 5704 2010-03-15 01:18:50Z Noguchi Isao $

menuconfig MSUDEV_KEYEV
    tristate "Support key event input device"
    default n

if MSUDEV_KEYEV


config MSUDEV_KEYEV_FIXED_DEVNUM
    boolean "Enabled to fixed major number"
    default n

config MSUDEV_KEYEV_FIXED_MAJOR
    int "Major number"
    depends on MSUDEV_KEYEV_FIXED_DEVNUM
    default 245

config MSUDEV_KEYEV_FIXED_MINOR
    int "Minor number"
    depends on MSUDEV_KEYEV_FIXED_DEVNUM
    default 33

choice
    boolean "Select lower level device"
    default MSUDEV_KEYEV_DEV_NONE

config MSUDEV_KEYEV_DEV_GPIO
    boolean "lower-level driver inplemented for GPIO"
    depends on MSUDEV_KEYEV

config MSUDEV_KEYEV_DEV_NONE
    boolean "lower-level driver is NOT exit"
    depends on MSUDEV_KEYEV

endchoice

config MSUDEV_KEYEV_PROC
    boolean "Support /proc file for debug"
    default n
    depends on PROC_FS


endif # MSUDEV_KEYEV
```

## drivers/p2pf/msudev/led/Kconfig
```kconfig
# drivers/p2pf/msudev/led/Kconfig
# $Id: Kconfig 5704 2010-03-15 01:18:50Z Noguchi Isao $

menuconfig MSUDEV_LED
    tristate "Support LED device"
    default n

if MSUDEV_LED


config MSUDEV_LED_FIXED_DEVNUM
    boolean "Enabled to fixed major number"
    default n

config MSUDEV_LED_FIXED_MAJOR
    int "Major number"
    depends on MSUDEV_LED_FIXED_DEVNUM
    default 245

config MSUDEV_LED_FIXED_MINOR
    int "Minor number"
    depends on MSUDEV_LED_FIXED_DEVNUM
    default 34


choice
    boolean "Select lower level device"
    default MSUDEV_LED_DEV_NONE

config  MSUDEV_LED_DEV_DUMMY
    boolean "dummy lower-level driver"
    depends on MSUDEV_LED

config MSUDEV_LED_DEV_FPGA
    boolean "lower-level driver inplemented on FPGA"
    depends on MSUDEV_LED

config MSUDEV_LED_DEV_NONE
    boolean "lower-level driver is NOT exit"
    depends on MSUDEV_LED

endchoice

# for dummy LED
if MSUDEV_LED_DEV_DUMMY

config MSUDEV_LED_DEV_DUMMY_NUMBER
    int "number of dummy led"
    default 1

endif # MSUDEV_LED_DEV_DUMMY

# for LED implemented on FPGA
if MSUDEV_LED_DEV_FPGA

config MSUDEV_LED_DEV_FPGA_OF
    bool "getting resouces by OF description"
    default y

config MSUDEV_LED_DEV_FPGA_NUMBER
    int "number of led"
    depends on !MSUDEV_LED_DEV_FPGA_OF
    default 1

config MSUDEV_LED_DEV_FPGA_PADDR
    hex "physical start address of registers"
    depends on !MSUDEV_LED_DEV_FPGA_OF
    
config MSUDEV_LED_DEV_FPGA_PSIZE
    hex "byte size of registers"
    depends on !MSUDEV_LED_DEV_FPGA_OF

endif # MSUDEV_LED_DEV_FPGA

config MSUDEV_LED_PROC
    boolean "Support /proc file for debug"
    default n
    depends on PROC_FS


endif # MSUDEV_LED
```

## drivers/p2pf/p2gpio/Kconfig
```kconfig
# P2PF GPIO driver configuration
## $Id: Kconfig 17953 2011-12-13 04:25:46Z Yoshioka Masaki $

menuconfig P2GPIODRV
	tristate "P2PF GPIO driver"
    depends on P2IOPORTDRV=n
    default n
	select GENERIC_GPIO
	select ARCH_REQUIRE_GPIOLIB

if P2GPIODRV

choice
	prompt "Board type"
	depends on P2GPIODRV
    default P2GPIO_UNKNOWN

config P2GPIO_UNKNOWN
    bool "UNKNOWN"

config P2GPIO_K283
	bool "K283(AG-HPX250)"
	select PPC_83xx_GPIO
	select CODECFPGA_GPIO

config P2GPIO_K298
	bool "K298(AJ-MSU10)"
	select PPC_83xx_GPIO
	select CODECFPGA_GPIO

config P2GPIO_K302
	bool "K302(AG-HPD24)"
	select PPC_83xx_GPIO

config P2GPIO_K301
	bool "K301(AG-3DP1)"
	select PPC_83xx_GPIO

config P2GPIO_K318
	bool "K318(AG-HPX600)"
	select PPC_83xx_GPIO
	select CODECFPGA_GPIO


endchoice


config P2GPIO_FIXED_DEVNUM
    boolean "Enabled to fixed major number"
    default n

config P2GPIO_FIXED_MAJOR
    int "Major number"
    depends on P2GPIO_FIXED_DEVNUM
    default 245

config P2GPIO_FIXED_MINOR
    int "Minor number"
    depends on P2GPIO_FIXED_DEVNUM
    default 0


endif # P2GPIODRV
```

## drivers/p2pf/p2ioport/Kconfig
```kconfig
# P2PF I/O port(inc. GPIO) access driver configuration
## $Id: Kconfig 10661 2010-11-25 05:12:02Z Yoshioka Masaki $

config P2IOPORTDRV
	tristate "P2PF I/O port(GPIO) access driver"
	---help---
	  This option is for accessing I/O port and GPIO for P2PF.

	  If unsure, say Y.


if P2IOPORTDRV

choice
	prompt "Board type"
	depends on P2IOPORTDRV

config P2IOPORT_HPM200
	bool "AJ-HPM200"

config P2IOPORT_K286
	bool "K286(AJ-HPD2500)"

config P2IOPORT_K298
	bool "K298(AJ-MSU10)"
	select GENERIC_GPIO
	select ARCH_REQUIRE_GPIOLIB
	select PPC_83xx_GPIO
	select CODECFPGA_GPIO
	select P2IOPORT_GPIO_LIB

config P2IOPORT_PCD2
	bool "AJ-PCD2"

config P2IOPORT_HMC80
	bool "AG-HMC80"

config P2IOPORT_HPX3100
	bool "AJ-HPX3100"

config P2IOPORT_K301
	bool "AG-3DP1"

config P2IOPORT_SAV8313BRB1
	bool "SAV8313BRB1"

#config P2IOPORT_MPC8313ERDB
#	bool "MPC8313ERDB"

config P2IOPORT_MPC837XERDB
	bool "MPC837xERDB(black case)"

endchoice

config P2IOPORT_GPIO_LIB
	bool
	default n

endif


config P2IOPORT_MPC83XXGPIOINT
	bool "MPC83XX GPIO INT support"
	depends on P2IOPORTDRV
```

## drivers/p2pf/p2pfinfo/Kconfig
```kconfig
# P2PF infomation module configuration
## $Id: Kconfig 3880 2009-09-07 00:36:35Z Noguchi Isao $

## CONFIG_P2PF_TARGET
config P2PF_TARGET
	string "P2PF Target type"
	default "Kxxx"
	---help---
	  This option indicates P2PF target type (ex. K000).


## CONFIG_P2PF_HW_VERSION
config P2PF_HW_VERSION
	int "P2PF hardware version"
	default 0
	---help---
	  This option indicates P2PF hardware version number.


## CONFIG_P2PF_VERINFO & CONFIG_P2PF_VERINFO_FILE

config P2PF_VERINFO
	bool "Use P2PF kernel version information"
	default n

config P2PF_VERINFO_FILE
	string "File written P2PF kernel version information under TOPDIR --- format is X.XX-XX-X.XX"
    depends on P2PF_VERINFO = y
    default "X.XX-XX-X.XX"


## CONFIG_PROC_P2PF
menuconfig PROC_P2PF
	bool "Support /proc/p2pf"
	depends on PROC_FS = y
    default n

if PROC_P2PF
    
# /proc/p2pf/bootmode
config PROC_P2PF_BOOTMODE
	bool    "Enable /proc entry for boot mode (/proc/p2pf/bootmode)"
	default n

choice
	prompt "Choice boot mode (ROM/NFS/VUP)"
	depends on PROC_P2PF_BOOTMODE = y

config PROC_P2PF_BOOTMODE_ROM
	bool "ROM"

config PROC_P2PF_BOOTMODE_NFS
	bool "NFS"

config PROC_P2PF_BOOTMODE_VUP
	bool "VUP"

endchoice

# /proc/p2pf/target, /proc/p2pf/hw_version
config PROC_P2PF_TARGET
	bool "Enable /proc entry for P2PF_TARGET & P2PF_HW_VERSION (/proc/p2pf/target, hw_version)"
	default n

endif # PROC_P2PF
```

## drivers/p2pf/pm/Kconfig
```kconfig
# drivers/p2pf/pm/Kconfig
# $Id: Kconfig 5088 2010-02-09 02:49:16Z Sawada Koji $

menuconfig P2PF_PM
	bool "Power management depending on P2PF machines" 
    default n
	help
	  Select this option if you don't have magic firmware for drivers that
	  need it.
	  If unsure, say Y.

if P2PF_PM

config P2PF_PM_POFF
    bool "Support power-off control"
    default n

config P2PF_PM_POFF_GPIO
    bool "Using GPIO for power-off signal"
    depends on P2PF_PM_POFF
	select GENERIC_GPIO
	select ARCH_REQUIRE_GPIOLIB
    default y

if P2PF_PM_POFF_GPIO

config P2PF_PM_POFF_GPIO_OF
    bool "Getting GPIO setting by OF description"
    default y

config P2PF_PM_POFF_GPIO_PORT
    int "GPIO port number for power-off signal"
    depends on !P2PF_PM_POFF_GPIO_OF

choice
    bool "Porality of GPIO port for power-off"
    depends on !P2PF_PM_POFF_GPIO_OF

config P2PF_PM_POFF_GPIO_POL_HIGH
    bool "Active-HIGH"

config P2PF_PM_POFF_GPIO_POL_LOW
    bool "Active-LOW"

endchoice

endif # P2PF_PM_POFF_GPIO

endif # P2PF_PM
```

## drivers/p2pf/rtctrl/Kconfig
```kconfig
# RT control driver configuration

config RTCTRL
	bool "RT control support"
	depends on BLOCK
	---help---
	  This option is for RT control, RT_On/Off and delay process for
	  Non-Realtime file.

	  If unsure, say Y.

config RTCTRLDRV
	tristate "RT control driver"
	depends on RTCTRL
	---help---
	  This driver is for RT control.
	  Use char-major-252-minor-$(MAJOR) device files: /dev/rtctrl_$(MAJOR),
	  $(MAJOR) is a number of driver you want to control RT_On/Off.

	  If unsure, say Y.

config DELAYPROC
	bool "Delay write process support"
	depends on RTCTRL
	---help---
	  This option is for delay write process for new P2 card.

	  If unsure, say N.

config DELAYPROC_WRITE_ORDER
	bool "Delay write order support"
	depends on DELAYPROC
	---help---
	  This option is defined the order of delayproc writing.

	  If unsure, say N.
```

## drivers/p2pf/verify/Kconfig
```kconfig
# drivers/p2pf/verify/Kconfig
# $Id: Kconfig 8573 2010-07-30 10:46:09Z Noguchi Isao $

menuconfig P2VERIFY
	tristate "Verifier support" 
    default n
	help
	  Select this option if you don't have magic firmware for drivers that
	  need it.
	  If unsure, say Y.

if P2VERIFY

config P2VERIFY_FIXED_DEVNUM
    boolean "Enabled to fixed major number"
    default n

config P2VERIFY_FIXED_MAJOR
    int "Major number"
    depends on P2VERIFY_FIXED_DEVNUM
    default 124

config P2VERIFY_FIXED_MINOR
    int "Minor number"
    depends on P2VERIFY_FIXED_DEVNUM
    default 255

config P2VERIFY_PROC
    boolean "Support /proc file for debug"
    default n
    depends on PROC_FS


endif # P2VERIFY
```

## drivers/p2pf/zcom/Kconfig
```kconfig
## $Id: Kconfig 13117 2011-03-10 04:38:15Z Noguchi Isao $

menuconfig ZCOM
        bool "Zion Com Port Driver"
        depends on ZION


if ZCOM

config ZCOM_OPTION
    bool "Enable ZCOM option settings"
    default n

config ZCOM_TX_BUFFER_NUM
    int "Buffer number for TX packets"
    default 64
    depends on ZCOM_OPTION

config ZCOM_RX_BUFFER_NUM
    int "Buffer number for RX packets"
    default 64
    depends on ZCOM_OPTION

config ZCOM_LOG_BUFFER_NUM
    int "Buffer number for LOG"
    default 64
    depends on ZCOM_OPTION


endif # ZCOM
```

## drivers/p2pf/zion/AudioProc/Kconfig
```kconfig
config ZION_AUDIOPROC
	bool "Support Audio Proc"
	help
	  Select this option if you don't have magic firmware for drivers that
	  need it.

	  If unsure, say Y.
```

## drivers/p2pf/zion/DMAIF/Kconfig
```kconfig
config ZION_DMAIF
	bool "Support DMAIF" if !ZION_DVCIF
	help
	  Select this option if you don't have magic firmware for drivers that
	  need it.

	  If unsure, say Y.
```

## drivers/p2pf/zion/DUELcore/Kconfig
```kconfig
config ZION_DUELCORE
	bool "Support DUEL Core"
	help
	  Select this option if you don't have magic firmware for drivers that
	  need it.

	  If unsure, say Y.
```
