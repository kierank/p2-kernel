## drivers/p2pf/zion/DVCIF/Kconfig
```kconfig
config ZION_DVCIF
	bool "Support DVC IF"
	default y
	help
	  Select this option if you don't have magic firmware for drivers that
	  need it.

	  If unsure, say Y.
```

## drivers/p2pf/zion/HOSTIF/Kconfig
```kconfig
config ZION_HOSTIF
	bool "Support HOST IF"
	help
	  Select this option if you don't have magic firmware for drivers that
	  need it.

	  If unsure, say Y.
```

## drivers/p2pf/zion/Kconfig
```kconfig
## $Id: Kconfig 13117 2011-03-10 04:38:15Z Noguchi Isao $

menuconfig ZION
    tristate "Panasonic ZION Support"
    default n
	help
        Select this option if you support Panasonic ZION Chip.

if ZION
	source drivers/p2pf/zion/AudioDSP/Kconfig
	source drivers/p2pf/zion/DMAIF/Kconfig
	source drivers/p2pf/zion/DVCIF/Kconfig
	source drivers/p2pf/zion/NEOctrl/Kconfig
	source drivers/p2pf/zion/ROMIF/Kconfig
	source drivers/p2pf/zion/AudioProc/Kconfig
	source drivers/p2pf/zion/DUELcore/Kconfig
	source drivers/p2pf/zion/HOSTIF/Kconfig
	source drivers/p2pf/zion/Matrix/Kconfig
	source drivers/p2pf/zion/PCI/Kconfig
	source drivers/p2pf/zion/VGA/Kconfig

	config ZION_REDUCE_SDRAM_BY_HALF
		bool "Reduce ZION SDRAM by half"
        default n
		help
		  Select this option if you reduce ZION SDRAM by half.

		  If unsure, say N.

endif # ZION
```

## drivers/p2pf/zion/NEOctrl/Kconfig
```kconfig
config ZION_NEOCTRL
	bool "Support NEO Control"
	default y
	help
	  Select this option if you don't have magic firmware for drivers that
	  need it.

	  If unsure, say Y.
```

## drivers/p2pf/zion/PCI/Kconfig
```kconfig
# ZION PCI configuration
## $Id: Kconfig 10442 2010-11-16 05:33:35Z Noguchi Isao $

config ZION_PCI
	bool "Support PCI IF"
	default y
	help
	  Select this option if you don't have magic firmware for drivers that
	  need it.

	  If unsure, say Y.

if ZION_PCI
config ZION_SUPPRESS_MASTER_ACTION
	bool "Support Target Transfer Only"
	default y
        help
          Select this option if you don't have magic firmware for drivers that
          need it.

          If unsure, say Y.

endif

config ZION_PCI_WAIT_INIT
    bool "Wait ZION initialization by SYSCON"
    depends on ZION_PCI
    depends on P2IOPORTDRV || P2GPIODRV
    default n
```

## drivers/p2pf/zion/ROMIF/Kconfig
```kconfig
config ZION_ROMIF
	bool "Support ROM IF"
	help
	  Select this option if you don't have magic firmware for drivers that
	  need it.

	  If unsure, say Y.
```

## drivers/p2pf/zion/VGA/Kconfig
```kconfig
# drivers/p2pf/zion/VGA/Kconfig

if FB && ZION_PCI
menu "ZION VGA Driver"

config ZION_VGA
	bool "Support ZION VGA"
	help
	  Select this option if you don't have magic firmware for drivers that
	  need it.

	  If unsure, say Y.

if ZION_VGA
config ZION_VGA_AUTOMATIC_UPDATE
        bool "Update Display Image Automatically"
        help
          Select this option if you don't have magic firmware for drivers that
          need it.

          If unsure, say Y.

config ZION_VGA_DMA_DIRECTION_CHANGE
	bool "Change FB Region for each DMA Transfer"
        help
          Select this option if you don't have magic firmware for drivers that
          need it.

          If unsure, say Y.

config ZION_FB_SETUP
        bool "Set FrameBuffer Address"
        help
          Select this option if you don't have magic firmware for drivers that
          need it.

          If unsure, say Y.

config ZION_FB_FIRST_ADDR
	hex "First Frame Buffer" if ZION_FB_SETUP
	default 07E60000

config ZION_FB_SECOND_ADDR
	hex "Second Frame Buffer" if ZION_FB_SETUP
	default 07F30000

config ZION_RESOLUTION_SETUP
        bool "Set Resolution Size"
        help
          Select this option if you don't have magic firmware for drivers that
          need it.
          If unsure, say Y.

config ZION_X_RESOLUTION
	int "X Resolution" if ZION_RESOLUTION_SETUP
	default 640

config ZION_Y_RESOLUTION
	int "Y Resolution" if ZION_RESOLUTION_SETUP
	default 480 

endif

endmenu
endif
```

## drivers/pci/Kconfig
```kconfig
#
# PCI configuration
#
## $Id: Kconfig 11381 2010-12-23 22:37:43Z Noguchi Isao $

config ARCH_SUPPORTS_MSI
	bool
	default n

config PCI_MSI
	bool "Message Signaled Interrupts (MSI and MSI-X)"
	depends on PCI
	depends on ARCH_SUPPORTS_MSI
	help
	   This allows device drivers to enable MSI (Message Signaled
	   Interrupts).  Message Signaled Interrupts enable a device to
	   generate an interrupt using an inbound Memory Write on its
	   PCI bus instead of asserting a device IRQ pin.

	   Use of PCI MSI interrupts can be disabled at kernel boot time
	   by using the 'pci=nomsi' option.  This disables MSI for the
	   entire system.

	   If you don't know what to do here, say N.

config PCI_LEGACY
	bool "Enable deprecated pci_find_* API"
	depends on PCI
	default y
	help
	  Say Y here if you want to include support for the deprecated
	  pci_find_slot() and pci_find_device() APIs.  Most drivers have
	  been converted over to using the proper hotplug APIs, so this
	  option serves to include/exclude only a few drivers that are
	  still using this API.

config PCI_DEBUG
	bool "PCI Debugging"
	depends on PCI && DEBUG_KERNEL
	help
	  Say Y here if you want the PCI core to produce a bunch of debug
	  messages to the system log.  Select this if you are having a
	  problem with PCI support and want to see more of what is going on.

	  When in doubt, say N.

config HT_IRQ
	bool "Interrupts on hypertransport devices"
	default y
	depends on PCI && X86_LOCAL_APIC && X86_IO_APIC
	help
	   This allows native hypertransport devices to use interrupts.

	   If unsure say Y.

## 2010/12/9, added by Panasonic (SAV) ==>
config PPC_MPC83XX_PCI_IOMAP
    bool "Improvement of PCI/PCIe I/O area mapping for MPC837x and MPC831x"
	depends on PCI
	depends on PPC_MPC837x || PPC_MPC831x
    default n
    help
        This option enables the improvement of PCI/PCIe I/O area mapping for
        MPC837x and MPC831x
## <=== 2010/12/9, added by Panasonic (SAV)


## 2010/12/21, modified by Panasonic (SAV) --->
config SUPPORT_CARDBUS_SIZE
    bool "Enable to change default mem/io region size for CardBus bridge"
	depends on PCI
    default n
    help
        This option enables to change defalt mem/io region size for
        CardBus bridge

config CARDBUS_MEM_SIZE
    hex "Memory region size for CardBus bridge"
    depends on SUPPORT_CARDBUS_SIZE
    default 0x4000000

config CARDBUS_IO_SIZE
    hex "I/O region size for CardBus bridge"
    depends on SUPPORT_CARDBUS_SIZE
    default 0x100
## <--- 2010/12/21, modified by Panasonic (SAV)
```
